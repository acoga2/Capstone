// This sketch is meant to test the UI on the display

#include <EEPROM.h> // For saving current frequency and volume values

// Includes and defines for SSD1306 display
#include <SPI.h>
#include <Wire.h>
#include <Adafruit_GFX.h>
#include <Adafruit_SSD1306.h>

#define SCREEN_WIDTH 128 // OLED display width, in pixels
#define SCREEN_HEIGHT 64 // OLED display height, in pixels

// Custom icon: Team Logo

#define LOGO_WIDTH 128 // In pixels
#define LOGO_HEIGHT 64

const unsigned char TeamLogo[] PROGMEM = {
0xFF, 0xFF, 0xFF, 0xFF, 0xFF, 0xFF, 0xFF, 0xFF, 0xFF, 0xFF, 0xFF, 0xFF, 0xFF, 0xFF, 0xFF, 0xFF,
0x80, 0x00, 0x00, 0x00, 0x00, 0x00, 0x00, 0x00, 0x00, 0x00, 0x00, 0x00, 0x00, 0x00, 0x00, 0x01,
0xBF, 0xFF, 0xFF, 0xFF, 0xFF, 0xFF, 0xFF, 0xFF, 0xFF, 0xFF, 0xFF, 0xFF, 0xFF, 0xFF, 0xFF, 0xFD,
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0xFF, 0xFF, 0xFF, 0xFF, 0xFF, 0xFF, 0xFF, 0xFF, 0xFF, 0xFF, 0xFF, 0xFF, 0xFF, 0xFF, 0xFF, 0xFF
};

#define OLED_RESET     -1 // Reset pin # (or -1 if sharing Arduino reset pin)
#define SCREEN_ADDRESS 0x3D ///< See datasheet for Address; 0x3D for 128x64, 0x3C for 128x32
Adafruit_SSD1306 display(SCREEN_WIDTH, SCREEN_HEIGHT, &Wire, OLED_RESET);

// Input/Ouptut pins (404 mode)

#define mode        D4  // AM/FM mode selection switch

#define volIn       A2  // Volume control
#define freqIn      A3  // Frequency control

 // Variables
 bool FM = true, AM = false;             // FM/AM modes, in FM by default
 bool modeCur = false, modePrev = false; // Mode change detection
 float freq = 88.1, freqold = 88.1, fstep = 0.2, fsave = 540;      // Frequency variables
 float vol = 50, volold = 50, volstep = 1;            // Volume variables
 float temp = 0;                         // Temporary variable
 bool firstloop = true;                  // First loop flag. Goes false after one loop
 int addr = 0;                           // Address to write to EEPROM

// Test Variables
 char readin;
 bool myconf = false;
 bool mymode = false; // Manually set mode. false = FM, true = AM
 int myfreq = 1;      // Frequency rotary encoder. 0 = down, 1 = same, 2 = up
 int myvol = 1;       // Volume rotary encoder. 0 = down, 1 = same, 2 = up
 // Manually set an RBDS bitstream, simulating a demodulated block that would be passed to MCU serially from the receivers
 bool myRBDS[104] = {0, 0, 0, 0, 0, 0, 0, 0, 0, 0, 0, 0, 0,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 0, 0};

void setup() {
  Serial.begin(9600);
  
  // SSD1306_SWITCHCAPVCC = generate display voltage from 3.3V internally
  if(!display.begin(SSD1306_SWITCHCAPVCC, SCREEN_ADDRESS)) {
    Serial.println(F("SSD1306 allocation failed"));
    for(;;); // Don't proceed, loop forever
  }

  // Clear the buffer
  display.clearDisplay();

  // Display the custom team logo for 5 seconds
  display.drawBitmap(
    (display.width()  - LOGO_WIDTH ) / 2,
    (display.height() - LOGO_HEIGHT) / 2,
    TeamLogo, LOGO_WIDTH, LOGO_HEIGHT, 1);
  display.display();
  delay(5000);
}

void loop() {
  // Clear display
  display.clearDisplay();

  // Get user inputs (403 mode)
  if (Serial.available() > 2) { // When inputs are queued...
    Serial.println(F("Inputs registered. Changing mode, freq, and vol..."));
    // Read 1 char for mode. 'f' for FM, 'a' for AM
    readin = Serial.read();
    /* if (readin != ('f' || 'a')) {
      readin = 'f';
    } */
    Serial.print("Read mode value = ");
    Serial.println(readin);
    // mymode = readin;
    if (readin == 'f') {
      mymode = false; // Save char to bool result. Makes comparisons easier later on
    }
    else {
      mymode = true;
    }
    // Read single char for frequency change. 's' for same, 'd' for down, 'u' for up
    readin = Serial.read();
    /* if (readin != ('s' || 'd' || 'u')) {
      readin = 's';
    } */
    Serial.print("Read freq value = ");
    Serial.println(readin);
    // myfreq = readin;
    if (readin == 's') {
      myfreq = 1; // Save char to int result
    }
    else if (readin == 'd') {
      myfreq = 0;
    }
    else {
      myfreq = 2;
    }
    // Read single char for volume change. 's' for same, 'd' for down, 'u' for up
    readin = Serial.read();
    /* if (readin != ('s' || 'd' || 'u')) {
      readin = 's';
    } */
    Serial.print("Read vol value = ");
    Serial.println(readin);
    // myvol = readin;
    if (readin == 's') {
      myvol = 1; // Save char to int result
    }
    else if (readin == 'd') {
      myvol = 0;
    }
    else {
      myvol = 2;
    }
    // Print saved bool and ints. These are what will be used for the rest of the loop
    Serial.print("Current mode = ");
    Serial.println(mymode);
    Serial.print("Current frequency change = ");
    Serial.println(myfreq);
    Serial.print("Current volume change = ");
    Serial.println(myvol);
    while (Serial.available() > 0) { // Clear input terminal of any extra user inputs, such as null or newline chars
      readin = Serial.read();        // These chars are still read as inputs and throw off the UI if not cleared out
    }
  }

  // Get user inputs (404 mode)
  // mymode = digitalRead(D4);
  // myfreq = analogRead(A3) / 204.8; // Analog pins are +0V to +5V, 1024 possible values
  // myvol  = analogRead(A2) / 204.8; // To convert int reading to 0-5V float, divide by 1024/5 = 204.8

  // Update mode
  if (mymode == false) {
    FM = true; // FM mode
    AM = false;
    modeCur = false; // FM mode
    fstep = 0.2; // Increase/decrease in steps of 0.2 MHz in FM mode
  } 
  else {
    FM = false;
    AM = true; // AM mode
    modeCur = true; // AM mode
    fstep = 10; // Increase/decrease in steps of 10 kHz in AM mode
  }
  if (modeCur != modePrev) {
    temp = freq;  // Swap saved frequency and current frequency (switch mode)
    freq = fsave; // freq will always have a frequency in the opposite mode of fsave
    fsave = temp;
    
    modePrev = modeCur;
  }

  // Display mode
  display.setTextSize(1); // Draw 1X-scale text
  display.setTextColor(SSD1306_WHITE);
  display.setCursor(0, 0);
  if (modeCur == false) {
    display.println("FM Mode");
  }
  else {
    display.println("AM Mode");
  }

  // Update frequency
  if (myfreq == 1) { // Keep same value
    freq = freq; // freq is current frequency
  }
  else if (myfreq == 0) { // Decrease
    freq = freq - fstep; // fstep is value to increase/decrease freq by
  }
  else { // Increase
    freq = freq + fstep;
  }

  // Limit frequency to allowed ranges
  if (modeCur == 0) { // FM
    if (freq > 108.0) {
      freq = 107.9; // Upper limit
    }
    else if (freq <= 88.0) {
      freq = 88.1; // Lower limit
    }
  }
  else { // AM
    if (freq >= 1700.0) {
      freq = 1700.0; // Upper limit
    }
    else if (freq < 540.0) {
      freq = 540.0; // Lower limit
    }
  }

  // Display frequency
  display.setTextSize(2); // Draw 2X-scale text
  display.setCursor(0, 12);
  display.print(freq, 1);
  if (modeCur == 0) {
    display.println(F(" MHz")); // Print MHz for FM
  }
  else {
    display.println(F(" kHz")); // Print kHz for AM
  }

  // Update volume
  if (myvol == 1) { // Keep same value
    vol = vol; // vol is current volume
  }
  else if (myvol == 0) { // Decrease
    vol = vol - volstep; // volstep is value to increase/decrease vol by
  }
  else { // Increase
    vol = vol + volstep;
  }

  // Limit volume
  if (vol > 100) {
    vol = 100;
  }
  else if (vol < 0) {
    vol = 0;
  }

  // Display volume
  display.setTextSize(1); // Draw 1X-scale text
  display.setCursor(0, 30);
  display.print(F("Vol: "));
  display.print(vol, 0);
  display.println(F("%"));

  // Update RBDS (FM only)
  if (modeCur == false) {
    
  }

  // Display RBDS (FM only)
  if (modeCur == false) {
    display.setCursor(0, 42);
    display.println(F("No channel info."));
  }

  // Update display
  display.display();      // Show initial text
  delay(5000);            // Optional delay between each update

  // Save values to EEPROM, currently unused
  /* EEPROM.write(0, modeCur);
  EEPROM.write(50, freq); 
  EEPROM.write(100, vol); */

  firstloop = false; // Stays false after loop runs once. Currently unused
}
